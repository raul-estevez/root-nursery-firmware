## main/Kconfig.projbuild
```kconfig
menu "WiFi configuration"

    config WIFI_SSID
        string "WiFi SSID"
        default "mywifi"
        help
            The SSID of the WiFi network to connect to.

    config WIFI_PASSWORD
        string "WiFi Password"
        default "mypassword"
        help
            The WiFi password.

    config MAX_RETRY
        int "Maximum retry count"
        default 5
        help
            How many times to retry before giving up.

endmenu

menu "MQTT configuration"

    config BROKER_URL
        string "Broker URL"
        default "mqtt://192.168.1.39"
        help
            URL of the MQTT broker e.g. mosquitto.

    config MQTT_TOPIC_DATA 
        string "MQTT data send Topic"
        default "nursery/nursery1"
        help
            MQTT topic to send data to.
endmenu

menu "I2C Configuration"

    config I2C_MASTER_SCL 
        int "SCL GPIO"
        default "9"
        help
            GPIO number for the I2C master clock.

    config I2C_MASTER_SDA 
        int "SDA GPIO"
        default "8"
        help
            GPIO number for the I2C master data. 
endmenu
```
